#include "oled.h"
#include "gpio.h"
#include "user_peripheral.h"
#include "user_periph_setup.h"
#define X_WIDTH 128
#define Y_WIDTH 64

 
unsigned char  F16x16[] = 	  	 
{  	  
0x40,0x40,0x80,0xF0,0x80,0x40,0x40,0x00,0x02,0x02,0x01,0x0F,0x01,0x02,0x02,0x00,/*"*",0*/
0x40,0x40,0x80,0xF0,0x80,0x40,0x40,0x00,0x02,0x02,0x01,0x0F,0x01,0x02,0x02,0x00,/*"*",1*/
0x40,0x40,0x80,0xF0,0x80,0x40,0x40,0x00,0x02,0x02,0x01,0x0F,0x01,0x02,0x02,0x00,/*"*",0*/
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0x00,0x00,0xFF,0x00,0x3F,0x10,0x10,0x10,0x9F,0x40,0x37,0x08,0x36,0x41,0x80,0x00,/*"?",7*/




};

unsigned char  BMP[] = 	  	 
{ 
0x00,0x00,0x00,0x00,0x00,0x00,0x00,0x00,0x00,0x00,0x00,0x00,0x00,0x00,0x00,0x00,
0x00,0x00,0x00,0x00,0x00,0x00,0x00,0x00,0x40,0xC0,0xC0,0xC0,0x80,0x80,0x00,0x00,
0x00,0x80,0x80,0xC0,0xC0,0xE0,0xE0,0xE0,0xE0,0xE0,0xE0,0x60,0x20,0x30,0x30,0x30,
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0x00,0x00,0x00,0x00,0x00,0x00,0x00,0x00,0x00,0x00,0x00,0x00,0x00,0x00,0x00,0x00,/*"C:\Users\salers\Desktop\0000.bmp",0*/
};

const unsigned char F16x32[][16] = {

{0x00,0x00,0x00,0x00,0x00,0x00,0x00,0x00,0x00,0x00,0x00,0x00,0x00,0x00,0x00,0x00},
{0x00,0x00,0x00,0x00,0x00,0x00,0x00,0x00,0xFE,0x00,0x00,0x00,0x00,0x00,0x00,0x00},
{0x00,0x00,0x01,0x01,0x01,0x01,0x01,0x01,0xFF,0x01,0x01,0x01,0x01,0x01,0x01,0x00},
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{0x00,0x00,0x00,0x00,0x00,0x00,0x00,0x00,0x00,0x00,0x00,0x00,0x00,0x00,0x00,0x00},/*"-",11*/



};

unsigned char  F8x16_bmp[][16] = {
{0xFE,0x02,0x02,0x03,0x03,0x02,0x02,0xFE,0xFF,0x80,0x80,0x80,0x80,0x80,0x80,0xFF},
{0xFE,0x02,0x02,0x03,0x03,0x02,0x02,0xFE,0xFF,0xC0,0xC0,0xC0,0xC0,0xC0,0xC0,0xFF},
{0xFE,0x02,0x02,0x03,0x03,0x02,0x02,0xFE,0xFF,0xE0,0xE0,0xE0,0xE0,0xE0,0xE0,0xFF},
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{0xFE,0xFE,0xFE,0xFF,0xFF,0xFE,0xFE,0xFE,0xFF,0xFF,0xFF,0xFF,0xFF,0xFF,0xFF,0xFF},
};

unsigned char F10x8_bmp[][10] = {
  {0x00,0x7E,0xFF,0xC3,0xC3,0xC3,0xC3,0xFF,0x7E,0x00},
	{0x08,0x08,0x3E,0x1C,0x08,0x1C,0x3E,0x08,0x08,0x00},
	{0x81,0xC3,0xE7,0xE7,0xBD,0x99,0x81,0x81,0x00,0x00},
	{0x00,0x00,0x00,0x00,0x00,0x00,0x00,0x00,0x00,0x00}
};

unsigned char F16x16_bmp[][16] = {
	{0x00,0x02,0x06,0x0A,0x12,0x22,0xC2,0x82,0x02,0x02,0x02,0x02,0x02,0x02,0x00,0x00},
	{0x00,0x40,0x60,0x50,0x48,0x44,0x42,0x41,0x40,0x40,0x40,0x40,0x40,0x40,0x40,0x00}, //sum
	
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	{0x00,0x00,0x00,0x00,0x00,0x00,0x00,0x00,0x00,0x00,0x00,0x00,0x00,0x00,0x00,0x00}, //clear
};
/************************************6*8???************************************/
const unsigned char  F6x8[][6] =		
{
0x00, 0x00, 0x00, 0x00, 0x00, 0x00,// sp
0x00, 0x00, 0x00, 0x2f, 0x00, 0x00,// !
0x00, 0x00, 0x07, 0x00, 0x07, 0x00,// "
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0x14, 0x14, 0x14, 0x14, 0x14, 0x14,// horiz lines
};

/****************************************8*16???************************************/
const unsigned char  F8X16[]=	  
{
  0x00,0x00,0x00,0x00,0x00,0x00,0x00,0x00,0x00,0x00,0x00,0x00,0x00,0x00,0x00,0x00,// 0
  0x00,0x00,0x00,0xF8,0x00,0x00,0x00,0x00,0x00,0x00,0x00,0x33,0x30,0x00,0x00,0x00,//! 1
  0x00,0x10,0x0C,0x06,0x10,0x0C,0x06,0x00,0x00,0x00,0x00,0x00,0x00,0x00,0x00,0x00,//" 2
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  0x00,0x06,0x01,0x01,0x02,0x02,0x04,0x04,0x00,0x00,0x00,0x00,0x00,0x00,0x00,0x00,//~ 94
};




/*********************LCD ÑÓÊ±1ms************************************/
void LCD_DLY_ms(unsigned int ms)
{                         
	unsigned int a;
	while(ms)
	{
	a=1800;
	while(a--);
	ms--;
	}
	return;
}
#define SIM_I2C 1
#ifdef OLED_SPI
/*********************LCDÐ´Êý¾Ý************************************/ 
void LCD_WrDat(unsigned char dat)	 
{
	unsigned char i;
	GPIO_SetActive(LCD_DC_PORT,LCD_DC);
	//LCD_DC=1;  
	for(i=0;i<8;i++) //·¢ËÍÒ»¸ö°ËÎ»Êý¾Ý 
	{
		if((dat << i) & 0x80)
		{GPIO_SetActive(LCD_SDIN_PORT,LCD_SDIN);}
		//{LCD_SDIN  = 1;}
		else
		//  LCD_SDIN  = 0;
		GPIO_SetInactive(LCD_SDIN_PORT,LCD_SDIN);
		GPIO_SetInactive(LCD_CLK_PORT,LCD_CLK);
		GPIO_SetActive(LCD_CLK_PORT,LCD_CLK);
		//LCD_CLK = 0;
		//LCD_CLK = 1;
	}
}
/*********************LCDÐ´ÃüÁî************************************/										
void LCD_WrCmd(unsigned char cmd)
{
	unsigned char i;
	GPIO_SetInactive(LCD_DC_PORT,LCD_DC);
	//LCD_DC=0;
	for(i=0;i<8;i++) //·¢ËÍÒ»¸ö°ËÎ»Êý¾Ý 
	{
		if((cmd << i) & 0x80)
		//{LCD_SDIN  = 1;}
		{
				GPIO_SetActive(LCD_SDIN_PORT,LCD_SDIN);
		}
		else 
		//	LCD_SDIN  = 0;
			GPIO_SetInactive(LCD_SDIN_PORT,LCD_SDIN);
		GPIO_SetInactive(LCD_CLK_PORT,LCD_CLK);
		GPIO_SetActive(LCD_CLK_PORT,LCD_CLK);
		//LCD_CLK = 0;
		//LCD_CLK = 1;
	}
}
#elif defined(SIM_I2C)

#define OLED_SCLK_Clr() GPIO_SetInactive(LCD_CLK_PORT, LCD_CLK )//SCL IIC
#define OLED_SCLK_Set() GPIO_SetActive(LCD_CLK_PORT, LCD_CLK )
#define OLED_SDIN_Clr() GPIO_SetInactive(LCD_SDIN_PORT, LCD_SDIN)//SDA IIC
#define OLED_SDIN_Set() GPIO_SetActive(LCD_SDIN_PORT, LCD_SDIN)



static void IIC_Start()
{
	OLED_SCLK_Set() ;
	OLED_SDIN_Set();
	OLED_SDIN_Clr();
	OLED_SCLK_Clr();
}
/**********************************************
//IIC Stop
**********************************************/
static void IIC_Stop()
{
	OLED_SCLK_Set();
	OLED_SDIN_Clr();
	OLED_SDIN_Set();
}


static  void IIC_Wait_Ack()
{
	OLED_SCLK_Set() ;
	OLED_SCLK_Clr();
}
/**********************************************
// IIC Write byte
**********************************************/

static void Write_IIC_Byte(unsigned char IIC_Byte)
{
	unsigned char i;
	unsigned char m,da;
	da=IIC_Byte;
    
	OLED_SCLK_Clr();
	for(i=0;i<8;i++)
	{
		m=da;
		// OLED_SCLK_Clr();
		m=m&0x80;
		if(m==0x80)
		{
			OLED_SDIN_Set();
		}
		else 
			OLED_SDIN_Clr();
		da=da<<1;
		OLED_SCLK_Set();
		OLED_SCLK_Clr();
	}
}

#else

#define SEND_I2C_COMMAND(X)                SetWord16(I2C_DATA_CMD_REG, (X))

#define WAIT_WHILE_I2C_FIFO_IS_FULL()      while((GetWord16(I2C_STATUS_REG) & TFNF) == 0)

#define WAIT_UNTIL_I2C_FIFO_IS_EMPTY()     while((GetWord16(I2C_STATUS_REG) & TFE) == 0)

#define WAIT_UNTIL_NO_MASTER_ACTIVITY()    while((GetWord16(I2C_STATUS_REG) & MST_ACTIVITY) !=0)

#define WAIT_FOR_RECEIVED_BYTE()           while(GetWord16(I2C_RXFLR_REG) == 0)
static void IIC_Start()
{
	
}
/**********************************************
//IIC Stop
**********************************************/
static void IIC_Stop()
{
	
}
static  void IIC_Wait_Ack()
{
	 WAIT_UNTIL_I2C_FIFO_IS_EMPTY();                         // Wait until Tx FIFO is empty
   WAIT_UNTIL_NO_MASTER_ACTIVITY();                        // Wait until no master activity
}
static void Write_IIC_Byte(unsigned char IIC_Byte)
{
		SEND_I2C_COMMAND(IIC_Byte);
}

#endif


/**************************************************

**************************************************/ 

#if 1
static void LCD_WrDat(uint8_t IIC_Data)
{
	IIC_Start();
	Write_IIC_Byte(0x78);           //Slave address,SA0=0
	IIC_Wait_Ack();

	Write_IIC_Byte(0x40);
	//write command
	IIC_Wait_Ack();

	Write_IIC_Byte(IIC_Data); 
	IIC_Wait_Ack();

	IIC_Stop();
}

static void LCD_WrCmd(uint8_t IIC_Command)
{
	IIC_Start();
	Write_IIC_Byte(0x78);            //Slave address,SA0=0
	IIC_Wait_Ack();

	Write_IIC_Byte(0x00);
	//write command
	IIC_Wait_Ack();

	Write_IIC_Byte(IIC_Command); 
	IIC_Wait_Ack();

	IIC_Stop();
}
#else
#define OLED_I2C_SLAVE_ADDRESS 0x78

static void LCD_WrDat(uint8_t IIC_Data)
{
		i2c_eeprom_init(OLED_I2C_SLAVE_ADDRESS, I2C_SPEED_MODE, I2C_ADDRESS_MODE, I2C_ADDRESS_SIZE);
		 int j;

    // Critical section
    GLOBAL_INT_DISABLE();

    i2c_send_address(address);

    for (j = 0; j < size; j++)
    {
        WAIT_WHILE_I2C_FIFO_IS_FULL();              // Wait if Tx FIFO is full
        SEND_I2C_COMMAND(0x0100);                   // Set read access for <size> times
    }

    // End of critical section
    GLOBAL_INT_RESTORE();

    // Get the received data
    for (j = 0; j < size; j++)
    {
        WAIT_FOR_RECEIVED_BYTE();                   // Wait for received data
        **p =(0xFF & GetWord16(I2C_DATA_CMD_REG));  // Get the received byte
        (*p)++;
    }

    WAIT_UNTIL_I2C_FIFO_IS_EMPTY();                 // Wait until Tx FIFO is empty
    WAIT_UNTIL_NO_MASTER_ACTIVITY();                // wait until no master activity	
		
}
static void LCD_WrCmd(uint8_t IIC_Command)
{

}



#endif



void LCD_Set_Pos(unsigned char x, unsigned char y) 
{ 
	LCD_WrCmd(0xb0+y);
	LCD_WrCmd(((x&0xf0)>>4)|0x10);
	LCD_WrCmd((x&0x0f)|0x01); 
} 
/*********************LCDÈ«ÆÁ************************************/
void LCD_Fill(unsigned char bmp_dat) 
{
	short y,x;
	for(y=0;y<8;y++)
	{
	LCD_WrCmd(0xb0+y);
	LCD_WrCmd(0x01);
	LCD_WrCmd(0x10);
	for(x=0;x<X_WIDTH;x++)
		LCD_WrDat(bmp_dat);
	}
}
/*********************LCD¸´Î»************************************/
void LCD_CLS(void)
{
	unsigned char y,x;	
	for(y=0;y<8;y++)
	{
	LCD_WrCmd(0xb0+y);
	LCD_WrCmd(0x01);
	LCD_WrCmd(0x10); 
	for(x=0;x<X_WIDTH;x++)
	LCD_WrDat(0);
	}
}
/*********************LCD³õÊ¼»¯************************************/
void LCD_Init(void)     
{  
	
	GPIO_SetActive(LCD_CLK_PORT,LCD_CLK);
	//LCD_CLK=1;
	GPIO_SetInactive(LCD_RST_PORT,LCD_RST);
	//LCD_RST=0;
	LCD_DLY_ms(50);
	GPIO_SetActive(LCD_RST_PORT,LCD_RST);
	//LCD_RST=1;       //
	LCD_WrCmd(0xae);//--turn off oled panel
	LCD_WrCmd(0x04);//---set low column address
	LCD_WrCmd(0x10);//---set high column address
	LCD_WrCmd(0x40);//--set start line address  Set Mapping RAM Display Start Line (0x00~0x3F)
	LCD_WrCmd(0x81);//--set contrast control register
	LCD_WrCmd(0xEf); // Set SEG Output Current Brightness
		//LCD_WrCmd(0xcf); // Set SEG Output Current Brightness
	LCD_WrCmd(0xa1);//--Set SEG/Column Mapping     0xa0×óÓÒ·´ÖÃ 0xa1Õý³£
	LCD_WrCmd(0xc8);//Set COM/Row Scan Direction   0xc0ÉÏÏÂ·´ÖÃ 0xc8Õý³£
	LCD_WrCmd(0xa6);//--set normal display
	LCD_WrCmd(0xa8);//--set multiplex ratio(1 to 64)
	LCD_WrCmd(0x3f);//--1/64 duty
	LCD_WrCmd(0xd3);//-set display offset	Shift Mapping RAM Counter (0x00~0x3F)
	LCD_WrCmd(0x00);//-not offset
	LCD_WrCmd(0xd5);//--set display clock divide ratio/oscillator frequency
	LCD_WrCmd(0x80);//--set divide ratio, Set Clock as 100 Frames/Sec
	LCD_WrCmd(0xd9);//--set pre-charge period
	LCD_WrCmd(0xf1);//Set Pre-Charge as 15 Clocks & Discharge as 1 Clock
	LCD_WrCmd(0xda);//--set com pins hardware configuration
	LCD_WrCmd(0x12);
	LCD_WrCmd(0xdb);//--set vcomh
	LCD_WrCmd(0x40);//Set VCOM Deselect Level
	LCD_WrCmd(0x20);//-Set Page Addressing Mode (0x00/0x01/0x02)
	LCD_WrCmd(0x02);//
	LCD_WrCmd(0x8d);//--set Charge Pump enable/disable
	LCD_WrCmd(0x14);//--set(0x10) disable
	LCD_WrCmd(0xa4);// Disable Entire Display On (0xa4/0xa5)
	LCD_WrCmd(0xa6);// Disable Inverse Display On (0xa6/a7) 
	LCD_WrCmd(0xaf);//--turn on oled panel
	LCD_Fill(0x00);  
	LCD_Set_Pos(-1,0); 	
} 

void LCD_P6x8Str(unsigned char x, unsigned char y,unsigned char ch[])
{
	unsigned char c=0,i=0,j=0;      
	while (ch[j]!='\0')
	{    
		c =ch[j]-32;
		if(x>126){x=0;y++;}
		LCD_Set_Pos(x,y);    
		for(i=0;i<6;i++)     
		LCD_WrDat(F6x8[c][i]);  
		x+=6;
		j++;
	}
}
/*******************功能描述：显示8*16一组标准ASCII字符串	 显示的坐标（x,y），y为页范围0～7****************/
void LCD_P8x16Str(unsigned char x, unsigned y,unsigned char ch[])
{
	unsigned char c=0,i=0,j=0;
	while (ch[j]!='\0')
	{    
		c =ch[j]-32;
		if(x>120){x=0;y++;}
		LCD_Set_Pos(x,y);    
		for(i=0;i<8;i++)     
		LCD_WrDat(F8X16[c*16+i]);
		LCD_Set_Pos(x,y+1);    
		for(i=0;i<8;i++)     
		LCD_WrDat(F8X16[c*16+i+8]);  
		x+=8;
		j++;
	}
}

void LCD_P16x32Str(unsigned char x, unsigned y,unsigned char ch[])
{
	unsigned char c=0,i=0,j=0;
	while (ch[j]!='\0')
	{    
		c =(ch[j]-0x2B)*4;
		if(x>120){x=0;y++;}
		
		LCD_Set_Pos(x,y);    
		for(i=0;i<16;i++)     
			LCD_WrDat(F16x32[c][i]);
		
		LCD_Set_Pos(x,y+1);    
		for(i=0;i<16;i++)     
			LCD_WrDat(F16x32[c+1][i]);  
		
		LCD_Set_Pos(x,y+2);    
		for(i=0;i<16;i++)     
			LCD_WrDat(F16x32[c+2][i]);  
		
		LCD_Set_Pos(x,y+3);    
		for(i=0;i<16;i++)     
			LCD_WrDat(F16x32[c+3][i]);  
		
		x+=16;
		j++;
	}
}

void LCD_P8x16Ch(unsigned char x, unsigned char y,unsigned char  N)
{
	unsigned char wm=0;
	unsigned int adder=16*N;  //  	
	LCD_Set_Pos(x , y);
	for(wm = 0;wm < 8;wm++)  //             
	{
		LCD_WrDat(F8x16_bmp[N][wm]);	
		adder += 1;
	}      
	LCD_Set_Pos(x,y + 1); 
	for(wm = 0;wm < 8;wm++) //         
	{
		LCD_WrDat(F8x16_bmp[N][wm+8]);
		adder += 1;
	} 	  	
}

void LCD_P10x8Ch(unsigned char x, unsigned char y,unsigned char  N)
{
	unsigned char wm=0;
	unsigned int adder=10*N;  //  	
	LCD_Set_Pos(x , y);
	for(wm = 0;wm < 10;wm++)  //             
	{
		LCD_WrDat(F10x8_bmp[N][wm]);	
	}      
	
}
void LCD_P16x16bmp(unsigned char x, unsigned char y,unsigned char  N)
{
	unsigned char wm=0;
	unsigned int adder=32*N;  //  	
	LCD_Set_Pos(x , y);
	for(wm = 0;wm < 16;wm++)  //             
	{
		LCD_WrDat(F16x16_bmp[N*2][wm]);	
		adder += 1;
	}      
	LCD_Set_Pos(x,y + 1); 
	for(wm = 0;wm < 16;wm++) //         
	{
		LCD_WrDat(F16x16_bmp[N*2+1][wm]);
		adder += 1;
	} 	  	
	
}
void LCD_P16x16Ch(unsigned char x, unsigned char y,unsigned char  N)
{
	unsigned char wm=0;
	unsigned int adder=32*N;  //  	
	LCD_Set_Pos(x , y);
	for(wm = 0;wm < 16;wm++)  //             
	{
		LCD_WrDat(F16x16[adder]);	
		adder += 1;
	}      
	LCD_Set_Pos(x,y + 1); 
	for(wm = 0;wm < 16;wm++) //         
	{
		LCD_WrDat(F16x16[adder]);
		adder += 1;
	} 	  	
}

void Draw_BMP(unsigned char x0, unsigned char y0,unsigned char x1, unsigned char y1,unsigned char BMP[])
{ 	
 unsigned int j=0;
 unsigned char x,y;
  
  if(y1%8==0) y=y1/8;      
  else y=y1/8+1;
	for(y=y0;y<y1;y++)
	{
		LCD_Set_Pos(x0,y);				
    for(x=x0;x<x1;x++)
	    {      
	    	LCD_WrDat(BMP[j++]);	    	
	    }
	}
} 
